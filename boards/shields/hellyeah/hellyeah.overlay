/ {
    chosen {
        zmk,kscan = &kscan0;
    };

    kscan0: kscan {
        compatible = "zmk,kscan-gpio-matrix";

        row-gpios = <
            &gpio0 6 GPIO_ACTIVE_LOW
            &gpio0 2 GPIO_ACTIVE_LOW
        >;

        col-gpios = <
            &gpio0 10 GPIO_ACTIVE_LOW
            &gpio0 9 GPIO_ACTIVE_LOW
            &gpio0 24 GPIO_ACTIVE_LOW
        >;

        diode-direction = "col2row";
    };

    kscan1: kscan_direct {
        compatible = "zmk,kscan-gpio-direct";

        input-gpios = <
            &gpio1 4 (GPIO_ACTIVE_LOW | GPIO_PULL_UP)
            &gpio1 0 (GPIO_ACTIVE_LOW | GPIO_PULL_UP)
        >;
    };
};