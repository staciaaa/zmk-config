## boards/shields/hellno/Kconfig.defconfig
```kconfig
if SHIELD_HELLNO

config ZMK_KEYBOARD_NAME
    default "xplotusv1.1"

endif # SHIELD_HELLNO
```

## boards/shields/hellyeah/Kconfig.defconfig
```kconfig
if SHIELD_HELLYEAH

config ZMK_KEYBOARD_NAME
    default "xplotus"

endif # SHIELD_HELLYEAH
```
